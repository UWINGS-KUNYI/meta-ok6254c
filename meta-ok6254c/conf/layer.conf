## meta-ok6254c/conf/layer.conf
```bitbake
# We have a conf and classes directory, append to BBPATH
BBPATH .= ":${LAYERDIR}"
METATIBASE := '${@os.path.normpath("${LAYERDIR}/")}'

# We have a recipes directory, add to BBFILES
BBFILES += "${LAYERDIR}/recipes*/*/*.bb ${LAYERDIR}/recipes*/*/*.bbappend"

BBFILE_COLLECTIONS += "meta-ok6254c"
BBFILE_PATTERN_meta-ok6254c := "^${LAYERDIR}/"
BBFILE_PRIORITY_meta-ok6254c = "16"

LAYERSERIES_COMPAT_meta-ok6254c = "kirkstone langdale"

LAYERDEPENDS_meta-ok6254c = " \
    meta-ti-bsp \
    meta-arm \
"
```

## meta-ok6254c/conf/machine/ok6254c-k3r5.conf
```bitbake
#@TYPE: Machine
#@NAME: OK6254-C (R5F)
#@DESCRIPTION: Machine configuration for the Forlinx OK6254-C Dev Board (R5F core)

require conf/machine/include/k3r5.inc

SYSFW_SOC = "am62x"
SYSFW_CONFIG = "evm"
SYSFW_SUFFIX = "gp"

UBOOT_MACHINE = "ok6254c_r5_defconfig"
```

## meta-ok6254c/conf/machine/ok6254c.conf
```bitbake
#@TYPE: Machine
#@NAME: OK6254-C
#@DESCRIPTION: Machine configuration for the Forlinx OK6254-C Dev Board

WKS_FILE ?= "sdimage-2part.wks"

require conf/machine/include/am62xx.inc


KERNEL_DEVICETREE = " \
    ti/ok6254c.dtb \
    ti/ok6254c-lvds.dtbo \
    ti/ok6254c-dpi.dtbo \
"

UBOOT_MACHINE = "ok6254c_a53_defconfig"
```
